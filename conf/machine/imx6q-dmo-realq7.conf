## conf/machine/imx6q-dmo-realq7.conf
```bitbake
#@TYPE: Machine
#@NAME: i.MX6Q SABRE Lite
#@DESCRIPTION: Machine configuration for Freescale i.MX6Q SABRE Lite

include conf/machine/include/imx-base.inc
include conf/machine/include/tune-cortexa9.inc

# barebox configurations
EXTRA_IMAGEDEPENDS = "barebox"
IMAGE_BOOTLOADER = "barebox"
BAREBOX_BINARY = "barebox-flash-image"
BAREBOX_MACHINE = "dmo-realq7_defconfig"
BAREBOX_ADD_FILES_TO_ENVIRONMENT = " \
    ${DEPLOY_DIR_IMAGE}/imx6q-dmo-realq7-1920x1080.dtb:/env/imx6q-dmo-realq7-1920x1080.dtb \
    ${DEPLOY_DIR_IMAGE}/imx6q-dmo-realq7-800x480.dtb:/env/imx6q-dmo-realq7-800x480.dtb \
"

# kernel configuration
PREFERRED_PROVIDER_virtual/kernel = "linux-dmo"
DMO_KERNEL_DEFCONFIG = ""
DMO_KERNEL_DEVICE_TREE_BLOBS_DEPLOY_DIR = " \
    imx6q-dmo-realq7-1920x1080.dtb \
    imx6q-dmo-realq7-800x480.dtb \
"
DMO_NO_FAT_FOR_KERNEL="1"


SOC_FAMILY = "mx6q:mx6"

SERIAL_CONSOLE = "115200 ttymxc1"

MACHINE_FEATURES += " pci"
```

## conf/machine/imx6q-dmo-vertigo.conf
```bitbake
#@TYPE: Machine
#@NAME: i.MX6Q Vertigo
#@DESCRIPTION: Machine configuration for Data-Modul Vetrigo Board

require conf/machine/imx6-dmo-vertigo-base.inc

BAREBOX_BINARY = "images/barebox-imx6q-dmo-vertigo.img"

KERNEL_DEVICETREE = "imx6q-dmo-vertigo-auo-g804sn05.dtb \
		     imx6q-dmo-vertigo-chimei-g070y2.dtb \
		     imx6q-dmo-vertigo-chimei-g101ICE.dtb "
DEFAULT_KERNEL_DEVICETREE = "imx6q-dmo-vertigo-chimei-g101ICE.dtb"

SOC_FAMILY = "mx6:mx6q"
```

## conf/machine/imx6s-dmo-vertigo.conf
```bitbake
#@TYPE: Machine
#@NAME: i.MX6Q edm-qmx6
#@DESCRIPTION: Machine configuration for vetrigo Board

require conf/machine/include/imx-base.inc
require conf/machine/include/tune-cortexa9.inc

MACHINEOVERRIDES =. "mx6:mx6dl:imx6-dmo-edm-qmx:"

# build this packages, but do not include in image
EXTRA_IMAGEDEPENDS = "virtual/bootloader virtual/kernel"

# Which type should be the image?
IMAGE_CLASSES += "dmo-images"
IMAGE_FSTYPES = "tar.bz2 ext4 dmosdcard"
IMAGE_TYPEDEP_czmsdcard = "ext4"

INITRAMFS_IMAGE = "dmo-image-initramfs"

# barebox configurations
IMAGE_BOOTLOADER = "barebox"
BAREBOX_BINARY = "images/barebox-czm-vertigo.img"
BAREBOX_MACHINE = "czm-vertigo_defconfig"
PREFERRED_PROVIDER_virtual/bootloader = "barebox"

# kernel configuration
KERNEL_IMAGETYPE = "zImage"
PREFERRED_PROVIDER_virtual/kernel = "linux-dmo"
#PREFERRED_VERSION_linux-dmo = "4.1.24%"
PREFERRED_VERSION_linux-dmo = "4.4%"
KERNEL_DEVICETREE = " \
    imx6s-czm-vertigo.dtb \
"
DEFAULT_KERNEL_DEVICETREE = "imx6s-czm-vertigo.dtb"

SOC_FAMILY = "mx6:mx6s:mx6dl"

SERIAL_CONSOLE = "115200 ttymxc0"

MACHINE_FEATURES += " pci"

SDCARD_WITH_SEPARATED_BARBOXENV = "false"

DMOFTP_append = "/edm-qmx6/source/"

# The image source can be set as url path or file.
# If the splash image is defined with file, it needs to be placed in dhe dietsplash
# folder.
SPLASH_SCREEN_IMAGE ?= "Logo_DM_HD.png"

# It seems, that the logo size is capped somwhere around WXGA (1280x800) or to
# be a bit more prezice, the byte size.
# The convert tool rssizes the image to match either the height or the width
# depending on the source image (portrait/landscapea)
# To force the given image, add an ! to the dimension. e.g. 800x480!
SPLASH_SCREEN_DIMENSION ?= "1280x800!"

SPLASH_SCREEN_PATH = "${COREBASE}/meta-dmo/conf/logos/"

SPLASH_SCREEN_TYPE ?= "kernel"
```

## conf/machine/imx6s-technoalpin-vertigo.conf
```bitbake
#@TYPE: Machine
#@NAME: i.MX6Q edm-qmx6
#@DESCRIPTION: Machine configuration for vetrigo Board

require conf/machine/imx6s-dmo-vertigo.conf

PREFERRED_VERSION_linux-dmo = "4.1.%"
KERNEL_DEVICETREE = "imx6s-tna-chimei-g101ICE.dtb"
DEFAULT_KERNEL_DEVICETREE = "imx6s-tna-chimei-g101ICE.dtb"
SPLASH_SCREEN_IMAGE = "BootLogo_20170918.png"
```

## conf/machine/splash-screen.inc
```bitbake
# splash-screen.inc
# Customer logo will be configured here

# - Copy logo image to folder meta-dmo/conf/logos/
#   and set logo name in SPLASH_SCREEN_IMAGE
# - Adapt resolution by setting SPLASH_SCREEN_DIMENSION
# - Set screen type by commenting/uncommenting the respective SPLASH_SCREEN_TYPE

# The image source can be set as url path or file.
# If the splash image is defined with file, it needs to be placed in the dietsplash
# folder.
SPLASH_SCREEN_IMAGE ?= "Logo_DM_HD_bw.png"

# It seems, that the logo size is capped somwhere around WXGA (1280x800) or to
# be a bit more precise, the byte size.
# The convert tool resizes the image to match either the height or the width
# depending on the source image (portrait/landscapea)
# To force the given image, add an ! to the dimension. e.g. 800x480!
SPLASH_SCREEN_DIMENSION ?= "800x480!"

SPLASH_SCREEN_PATH = "${COREBASE}/meta-dmo/conf/logos/"

SPLASH_SCREEN_TYPE ?= "dietsplash"
# SPLASH_SCREEN_TYPE ?= "kernel"
```

## recipes-bsp/linux/linux-dmo/imx6q-dmo-edm-qmx6/defconfig
```kconfig
# CONFIG_LOCALVERSION_AUTO is not set
CONFIG_KERNEL_LZO=y
CONFIG_SYSVIPC=y
CONFIG_POSIX_MQUEUE=y
CONFIG_NO_HZ=y
CONFIG_HIGH_RES_TIMERS=y
CONFIG_LOG_BUF_SHIFT=18
CONFIG_CGROUPS=y
CONFIG_RELAY=y
CONFIG_BLK_DEV_INITRD=y
CONFIG_EXPERT=y
# CONFIG_SLUB_DEBUG is not set
# CONFIG_COMPAT_BRK is not set
CONFIG_MODULES=y
CONFIG_MODULE_UNLOAD=y
CONFIG_MODVERSIONS=y
CONFIG_MODULE_SRCVERSION_ALL=y
CONFIG_DEFAULT_NOOP=y
CONFIG_ARCH_MXC=y
CONFIG_SOC_IMX6Q=y
CONFIG_SOC_IMX6Q_TEMP=y
CONFIG_SMP=y
CONFIG_VMSPLIT_2G=y
CONFIG_HOTPLUG_CPU=y
CONFIG_PREEMPT_VOLUNTARY=y
CONFIG_AEABI=y
# CONFIG_OABI_COMPAT is not set
# CONFIG_COMPACTION is not set
CONFIG_DEFAULT_MMAP_MIN_ADDR=32768
CONFIG_CMDLINE="noinitrd console=ttymxc0,115200"
CONFIG_CPU_FREQ=y
CONFIG_CPU_FREQ_DEFAULT_GOV_ONDEMAND=y
CONFIG_ARM_IMX6Q_CPUFREQ=y
CONFIG_CPU_FREQ_IMX=y
CONFIG_VFP=y
CONFIG_NEON=y
# CONFIG_SUSPEND is not set
CONFIG_NET=y
CONFIG_PACKET=y
CONFIG_UNIX=y
CONFIG_INET=y
CONFIG_IP_PNP=y
CONFIG_IP_PNP_DHCP=y
# CONFIG_INET_XFRM_MODE_TRANSPORT is not set
# CONFIG_INET_XFRM_MODE_TUNNEL is not set
# CONFIG_INET_XFRM_MODE_BEET is not set
# CONFIG_INET_LRO is not set
CONFIG_IPV6=y
# CONFIG_WIRELESS is not set
CONFIG_DEVTMPFS=y
CONFIG_DEVTMPFS_MOUNT=y
# CONFIG_STANDALONE is not set
# CONFIG_FIRMWARE_IN_KERNEL is not set
CONFIG_CMA=y
CONFIG_CMA_SIZE_MBYTES=128
CONFIG_CONNECTOR=y
CONFIG_PROC_DEVICETREE=y
CONFIG_SRAM=y
# CONFIG_SCSI_PROC_FS is not set
CONFIG_BLK_DEV_SD=y
CONFIG_SCSI_MULTI_LUN=y
CONFIG_SCSI_CONSTANTS=y
CONFIG_SCSI_LOGGING=y
CONFIG_SCSI_SCAN_ASYNC=y
# CONFIG_SCSI_LOWLEVEL is not set
CONFIG_ATA=y
# CONFIG_ATA_VERBOSE_ERROR is not set
# CONFIG_SATA_PMP is not set
CONFIG_SATA_IMX=y
# CONFIG_ATA_SFF is not set
CONFIG_NETDEVICES=y
CONFIG_MII=y
# CONFIG_NET_CADENCE is not set
# CONFIG_NET_VENDOR_BROADCOM is not set
# CONFIG_NET_VENDOR_CIRRUS is not set
# CONFIG_NET_VENDOR_FARADAY is not set
# CONFIG_NET_VENDOR_INTEL is not set
# CONFIG_NET_VENDOR_MARVELL is not set
# CONFIG_NET_VENDOR_MICREL is not set
# CONFIG_NET_VENDOR_MICROCHIP is not set
# CONFIG_NET_VENDOR_NATSEMI is not set
# CONFIG_NET_VENDOR_SEEQ is not set
# CONFIG_NET_VENDOR_SMSC is not set
# CONFIG_NET_VENDOR_STMICRO is not set
# CONFIG_NET_VENDOR_WIZNET is not set
# CONFIG_WLAN is not set
# CONFIG_INPUT_MOUSEDEV is not set
CONFIG_INPUT_EVDEV=y
# CONFIG_INPUT_KEYBOARD is not set
# CONFIG_INPUT_MOUSE is not set
# CONFIG_SERIO is not set
CONFIG_VT_HW_CONSOLE_BINDING=y
# CONFIG_LEGACY_PTYS is not set
# CONFIG_DEVKMEM is not set
CONFIG_SERIAL_IMX=y
CONFIG_SERIAL_IMX_CONSOLE=y
CONFIG_HW_RANDOM=y
# CONFIG_I2C_COMPAT is not set
CONFIG_I2C_CHARDEV=y
# CONFIG_I2C_HELPER_AUTO is not set
CONFIG_I2C_IMX=y
CONFIG_SPI=y
CONFIG_SPI_IMX=y
CONFIG_GPIO_SYSFS=y
CONFIG_GPIO_STMPE=y
CONFIG_SENSORS_AD7414=y
CONFIG_WATCHDOG=y
CONFIG_MFD_STMPE=y
CONFIG_REGULATOR=y
CONFIG_REGULATOR_ANATOP=y
CONFIG_REGULATOR_PF0100=y
CONFIG_MEDIA_SUPPORT=y
CONFIG_MEDIA_CAMERA_SUPPORT=y
CONFIG_MEDIA_USB_SUPPORT=y
CONFIG_USB_VIDEO_CLASS=m
# CONFIG_USB_GSPCA is not set
CONFIG_V4L_PLATFORM_DRIVERS=y
CONFIG_V4L_MEM2MEM_DRIVERS=y
CONFIG_VIDEO_CODA=y
CONFIG_VIDEO_IMX_IPU_OVL=y
CONFIG_VIDEO_IMX_IPU_SCALER=y
CONFIG_DRM=y
CONFIG_FRAMEBUFFER_CONSOLE=y
CONFIG_USB=y
CONFIG_USB_EHCI_HCD=y
CONFIG_USB_EHCI_MXC=y
CONFIG_USB_CHIPIDEA=y
CONFIG_USB_CHIPIDEA_HOST=y
CONFIG_USB_CHIPIDEA_DEBUG=y
CONFIG_USB_STORAGE=y
CONFIG_USB_GADGET=y
CONFIG_USB_ZERO=m
CONFIG_USB_CDC_COMPOSITE=m
CONFIG_USB_G_ACM_MS=m
CONFIG_USB_G_MULTI=m
CONFIG_USB_G_MULTI_CDC=y
CONFIG_USB_G_WEBCAM=m
CONFIG_USB_MXS_PHY=y
CONFIG_MMC=y
CONFIG_MMC_SDHCI=y
CONFIG_MMC_SDHCI_PLTFM=y
CONFIG_MMC_SDHCI_ESDHC_IMX=y
CONFIG_NEW_LEDS=y
CONFIG_RTC_CLASS=y
# CONFIG_RTC_SYSTOHC is not set
CONFIG_RTC_INTF_DEV_UIE_EMUL=y
CONFIG_RTC_DRV_M41T80=y
CONFIG_RTC_DRV_MXC=y
CONFIG_DMADEVICES=y
# CONFIG_MX3_IPU is not set
CONFIG_IMX_SDMA=y
CONFIG_STAGING=y
CONFIG_DRM_IMX=y
CONFIG_DRM_IMX_FB_HELPER=y
CONFIG_DRM_IMX_LDB=y
CONFIG_DRM_IMX_IPUV3_CORE=y
CONFIG_DRM_IMX_IPUV3=y
CONFIG_DRM_IMX_HDMI=y
CONFIG_MXC_GPU_VIV=y
CONFIG_COMMON_CLK_DEBUG=y
CONFIG_EXT4_FS=y
# CONFIG_DNOTIFY is not set
CONFIG_AUTOFS4_FS=y
CONFIG_MSDOS_FS=y
CONFIG_VFAT_FS=y
CONFIG_TMPFS=y
CONFIG_CONFIGFS_FS=m
# CONFIG_MISC_FILESYSTEMS is not set
CONFIG_NFS_FS=y
# CONFIG_NFS_V2 is not set
CONFIG_NFS_V4=y
CONFIG_NFS_V4_1=y
CONFIG_ROOT_NFS=y
CONFIG_NLS_DEFAULT="cp437"
CONFIG_NLS_CODEPAGE_437=y
CONFIG_NLS_ASCII=y
CONFIG_NLS_ISO8859_1=y
CONFIG_NLS_ISO8859_15=m
CONFIG_NLS_UTF8=y
CONFIG_PRINTK_TIME=y
# CONFIG_SCHED_DEBUG is not set
# CONFIG_DEBUG_BUGVERBOSE is not set
CONFIG_RCU_CPU_STALL_TIMEOUT=60
# CONFIG_FTRACE is not set
# CONFIG_ARM_UNWIND is not set
# CONFIG_CRYPTO_ANSI_CPRNG is not set
# CONFIG_CRYPTO_HW is not set
CONFIG_CRC_ITU_T=m
```
