## conf/bblayers.conf.sample
```bitbake
# LAYER_CONF_VERSION is increased each time build/conf/bblayers.conf
# changes incompatibly
LCONF_VERSION = "6"

BBPATH = "${TOPDIR}"
BBFILES ?= ""

BBLAYERS ?= " \
	##COREBASE##/meta \
	##COREBASE##/meta-dmo \
	##COREBASE##/meta-dmo-intern \
	##COREBASE##/meta-poky \
	##COREBASE##/meta-yocto-bsp \
	##COREBASE##/meta-intel \
	##COREBASE##/meta-freescale \
	##COREBASE##/meta-browser \
	##COREBASE##/meta-qt5 \
	##COREBASE##/meta-openembedded/meta-oe \
	##COREBASE##/meta-openembedded/meta-python \
	##COREBASE##/meta-openembedded/meta-gnome \
	##COREBASE##/meta-openembedded/meta-xfce \
	##COREBASE##/meta-openembedded/meta-multimedia \
	##COREBASE##/meta-openembedded/meta-filesystems \
	##COREBASE##/meta-openembedded/meta-networking \
"

BBLAYERS_NON_REMOVABLE ?= " \
	##COREBASE##/meta \
	##COREBASE##/meta-poky \
"
```

## conf/distro/base-dmo-systemd-distro.inc
```bitbake
# This is the basic distro for our systems. 
# It's planed to use this inc file as base for all distros, including customer
# specific version.
require conf/distro/poky.conf

# Set systemd as init system
DISTRO_FEATURES_append = " systemd "
VIRTUAL-RUNTIME_init_manager = " systemd "
VIRTUAL-RUNTIME_initscripts = ""

# disable this BACKFILL distro features
# you don't know what BACKFILL is? *tz* look here: http://patches.openembedded.org/patch/21849/
DISTRO_FEATURES_BACKFILL_CONSIDERED += " pulseaudio sysvinit "

# some license things here
LICENSE_FLAGS_WHITELIST += "commercial_libav commercial_x264"

# We always want to use package management
IMAGE_FEATURES += " package-management "

# Data-Modul FTP-Server
DMOFTP = "ftp://Public_EMB@ftp.data-modul.com"

# Ship all kernel modules by default
MACHINE_EXTRA_RRECOMMENDS = " kernel-modules"

# Remove files from comercial license recipes
#DMO_REMOVE_FILES_FROM_COMMERCIAL_RECIPES = "1"

PACKAGECONFIG_GL ?= "${@bb.utils.contains('DISTRO_FEATURES', 'opengl', 'gles2', '', d)}"
PACKAGECONFIG_append_pn-gstreamer1.0-plugins-bad += " \
    ${PACKAGECONFIG_GL} \
    ${@bb.utils.contains('DISTRO_FEATURES', 'wayland', 'wayland', '', d)} \
    ${@bb.utils.contains('DISTRO_FEATURES', 'bluetooth', 'bluez', '', d)} \
    ${@bb.utils.contains('DISTRO_FEATURES', 'directfb', 'directfb', '', d)} \
    orc curl uvch264 neon sndfile \
    hls sbc dash bz2 smoothstreaming faad faac\
    "
PACKAGECONFIG_append_pn-gstreamer1.0-plugins-base = " \
    ${@bb.utils.contains('DISTRO_FEATURES', 'x11', 'x11', '', d)} \
    ${@bb.utils.contains('DISTRO_FEATURES', 'alsa', 'alsa', '', d)} \
    orc ivorbis ogg theora vorbis \
    "
PREFERRED_VERSION_qupzilla ?= "2.0.2%"

PREFERRED_PROVIDER_jpeg ?= "jpeg"
PREFERRED_PROVIDER_jpeg-native ?= "jpeg-native"

PREFERRED_VERSION_kern-tools-native_git ?= "0.2+git83f468ab8ef748a8880cba7d26779c35abfcc0bf"

PREFERRED_VERSION_canutils ?= "git"

# We disable the vivante kernel modul, as we are using our own kernel
MACHINE_USES_VIVANTE_KERNEL_DRIVER_MODULE = "0"
```

## conf/distro/dmo-distro-qt.conf
```bitbake
require conf/distro/dmo-distro.inc

DISTROOVERRIDES.=":dmo-qt:dmo-qt-only"
DISTRO_NAME+="(Data Modul AG qt5 variant)"
DISTRO_FEATURES_remove = "x11 directfb wayland"
DISTRO_FEATURES_append = " linuxfb "

IMAGE_BASENAME.="-qt"
```

## conf/distro/dmo-distro-wayland.conf
```bitbake
require conf/distro/dmo-distro.inc

DISTROOVERRIDES.=":dmo-wayland:dmo-qt"
DISTRO_NAME+="(Data Modul AG wayland variant)"
DISTRO_FEATURES_remove = "x11 "
DISTRO_FEATURES_append = " wayland pam"

PACKAGECONFIG_append_pn-weston = " launch "

IMAGE_BASENAME.="-wayland"
```

## conf/distro/dmo-distro-x11.conf
```bitbake
require conf/distro/dmo-distro.inc

DISTROOVERRIDES.=":dmo-x11:dmo-qt"
DISTRO_NAME+="(Data Modul AG x11 variant)"

IMAGE_BASENAME.="-x11"
```

## conf/distro/dmo-distro.conf
```bitbake
require conf/distro/dmo-distro.inc

DISTRO_NAME+="(Data Modul AG variant)"
DISTRO_FEATURES_remove = "x11 directfb"
DISTRO_FEATURES_append = " linuxfb "
```

## conf/distro/dmo-distro.inc
```bitbake
require base-dmo-systemd-distro.inc

DISTRO_FEATURES_remove = "irda zeroconf 3g nfc"

PACKAGECONFIG_append_pn-systemd += "networkd resolved gcrypt"
PACKAGECONFIG_append_pn-qtbase += "tslib icu examples accessibility sql-sqlite fontconfig"

PREFERRED_VERSION_dmec-driver ?= "2017.07.31"
```

## conf/distro/poky-dmo-qt.conf
```bitbake
require conf/distro/poky-dmo.inc

DISTROOVERRIDES.=":dmo-qt"
DISTRO_NAME+="(Data Modul AG qt5 variant)"
DISTRO_FEATURES_remove = "x11 directfb"
DISTRO_FEATURES_append = " linuxfb "

IMAGE_BASENAME.="-qt"
```

## conf/distro/poky-dmo-x11.conf
```bitbake
require conf/distro/poky-dmo.inc

DISTROOVERRIDES.=":dmo-x11"
DISTRO_NAME+="(Data Modul AG x11 variant)"

IMAGE_BASENAME.="-x11"
```

## conf/machine/dmo-edm-comb-base.inc
```bitbake
#@TYPE: Machine
#@NAME: x86 edm-comb
#@DESCRIPTION: Machine configuration for Data-Modul eDM-comb

require conf/machine/intel-corei7-64.conf
do_rootfs[depends] += "intel-microcode:do_deploy"
do_rootfs[depends] += "grub-efi:do_populate_lic"

IMAGE_BOOTLOADER = "gummiboot"
EFI_PROVIDER = "grub-efi"

IMAGE_FSTYPES += "tar.bz2 hdddirect"

MACHINEOVERRIDES .= ":dmo-edm-comb"

PACKAGECONFIG_append_pn-gstreamer1.0-plugins-bad += "opengl"

# The image source can be set as url path or file.
# If the splash image is defined with file, it needs to be placed in dhe dietsplash
# folder.
SPLASH_SCREEN_IMAGE ?= "Logo_DM_HD_bw.png"

# It seems, that the logo size is capped somwhere around WXGA (1280x800) or to
# be a bit more prezice, the byte size.
# The convert tool rssizes the image to match either the height or the width
# depending on the source image (portrait/landscapea)
# To force the given image, add an ! to the dimension. e.g. 800x480!
SPLASH_SCREEN_DIMENSION ?= "1920x1080"

SPLASH_SCREEN_PATH = "${COREBASE}/meta-dmo/conf/logos/"

SPLASH_SCREEN_TYPE ?= "kernel"
```

## conf/machine/dmo-edm-comb-bs6.conf
```bitbake
#@TYPE: Machine
#@NAME: x86 edm-comb-bs6
#@DESCRIPTION: Machine configuration for Data-Modul eDM-comb-BS6

require conf/machine/dmo-edm-comb-base.inc
```

## conf/machine/dmo-edm-comb-bw6.conf
```bitbake
#@TYPE: Machine
#@NAME: x86 edm-comb-bw6
#@DESCRIPTION: Machine configuration for Data-Modul eDM-comb-BW6

require conf/machine/dmo-edm-comb-base.inc
```

## conf/machine/dmo-edm-comb-kl6.conf
```bitbake
#@TYPE: Machine
#@NAME: x86 edm-comb-bw6
#@DESCRIPTION: Machine configuration for Data-Modul eDM-comb-SL6

require conf/machine/dmo-edm-comb-base.inc
```

## conf/machine/dmo-version.conf
```bitbake
PREFERRED_PROVIDER_jpeg = "jpeg"
PREFERRED_PROVIDER_jpeg-native = "jpeg-native"

PREFERRED_VERSION_linux-dmo = "3.9rc7+git5be5151a6dc0860044e54a26606cdb3f5e3f72f5"
PREFERRED_VERSION_barebox = "2013.03.0-2013062101"
PREFERRED_VERSION_cpu-status-info = "0.1-2013062101"
```

## conf/machine/imx6-dmo-edm-qmx-base.inc
```bitbake
#@TYPE: Machine
#@NAME: i.MX6Q edm-qmx6
#@DESCRIPTION: Machine configuration for Data-Modul eDM-QMX6

require conf/machine/include/imx-base.inc
require conf/machine/include/tune-cortexa9.inc

# build this packages, but do not include in image
EXTRA_IMAGEDEPENDS = "virtual/bootloader virtual/kernel"

# Which type should be the image?
IMAGE_CLASSES += "dmo-images"
IMAGE_FSTYPES = "tar.bz2 ext4 dmosdcard"
IMAGE_TYPEDEP_dmosdcard = "ext4"

INITRAMFS_IMAGE = "dmo-image-initramfs"

# barebox configurations
IMAGE_BOOTLOADER = "barebox"
BAREBOX_MACHINE = "datamodul-edm-qmx6_defconfig"
PREFERRED_PROVIDER_virtual/bootloader = "barebox"

# kernel configuration
KERNEL_IMAGETYPE = "zImage"
PREFERRED_PROVIDER_virtual/kernel = "linux-dmo"

SERIAL_CONSOLE = "115200 ttymxc1"

MACHINE_FEATURES += " pci"

SDCARD_WITH_SEPARATED_BARBOXENV = "false"

DMOFTP_append = "/edm-qmx6/source/"

MACHINEOVERRIDES.=":imx6-dmo-edm-qmx"

# The image source can be set as url path or file.
# If the splash image is defined with file, it needs to be placed in dhe dietsplash
# folder.
SPLASH_SCREEN_IMAGE ?= "Logo_DM_HD_bw.png"

# It seems, that the logo size is capped somwhere around WXGA (1280x800) or to
# be a bit more prezice, the byte size.
# The convert tool rssizes the image to match either the height or the width
# depending on the source image (portrait/landscapea)
# To force the given image, add an ! to the dimension. e.g. 800x480!
SPLASH_SCREEN_DIMENSION ?= "800x480"

SPLASH_SCREEN_PATH = "${COREBASE}/meta-dmo/conf/logos/"

SPLASH_SCREEN_TYPE ?= "kernel"
```

## conf/machine/imx6-dmo-ppc-base.inc
```bitbake
#@TYPE: Machine
#@NAME: i.MX6Q edm-qmx6
#@DESCRIPTION: Machine configuration for PPC Board

require conf/machine/include/imx-base.inc
require conf/machine/include/tune-cortexa9.inc

MACHINEOVERRIDES =. "mx6:mx6dl:mx6q:imx6-dmo-edm-qmx:"

# build this packages, but do not include in image
EXTRA_IMAGEDEPENDS = "virtual/bootloader virtual/kernel"

# Which type should be the image?
IMAGE_CLASSES += "dmo-images"
IMAGE_FSTYPES = "tar.bz2 ext4 dmosdcard"
IMAGE_TYPEDEP_dmosdcard = "ext4"

INITRAMFS_IMAGE = "dmo-image-initramfs"

# barebox configurations
IMAGE_BOOTLOADER = "barebox-ppc"
BAREBOX_MACHINE = "dmo-imx6-ppc_defconfig"
PREFERRED_PROVIDER_virtual/bootloader = "barebox-ppc"

# kernel configuration
KERNEL_IMAGETYPE = "zImage"
PREFERRED_PROVIDER_virtual/kernel ?= "linux-dmo-ppc"

PREFERRED_VERSION_linux-dmo ?= "4.4.57%"

SERIAL_CONSOLE = "115200 ttymxc0"

MACHINE_FEATURES += " pci"

SDCARD_WITH_SEPARATED_BARBOXENV = "false"

DMOFTP_append = "/edm-qmx6/source/"

# The image source can be set as url path or file.
# If the splash image is defined with file, it needs to be placed in dhe dietsplash
# folder.
SPLASH_SCREEN_IMAGE ?= "Logo_DM_HD_bw.png"

# It seems, that the logo size is capped somwhere around WXGA (1280x800) or to
# be a bit more prezice, the byte size.
# The convert tool rssizes the image to match either the height or the width
# depending on the source image (portrait/landscapea)
# To force the given image, add an ! to the dimension. e.g. 800x480!
SPLASH_SCREEN_DIMENSION ?= "800x480!"

SPLASH_SCREEN_PATH = "${COREBASE}/meta-dmo/conf/logos/"

SPLASH_SCREEN_TYPE ?= "dietsplash"

PREFERRED_VERSION_gstreamer1.0 ?= "1.6.3"
PREFERRED_VERSION_gstreamer1.0-meta-base ?= "1.6.3"
PREFERRED_VERSION_gstreamer1.0-plugins-bad ?= "1.6.3"
PREFERRED_VERSION_gstreamer1.0-plugins-base ?= "1.6.3"
PREFERRED_VERSION_gstreamer1.0-plugins-good ?= "1.6.3"
PREFERRED_VERSION_gstreamer1.0-plugins-ugly ?= "1.6.3"
```

## conf/machine/imx6-dmo-vertigo-base.inc
```bitbake
#@TYPE: Machine
#@NAME: i.MX6Q edm-qmx6
#@DESCRIPTION: Machine configuration for Data Modul Vetrigo Board

require conf/machine/include/imx-base.inc
require conf/machine/include/tune-cortexa9.inc

MACHINEOVERRIDES =. "mx6:mx6dl:mx6q:imx6-dmo-edm-qmx:"

# build this packages, but do not include in image
EXTRA_IMAGEDEPENDS = "virtual/bootloader virtual/kernel"

# Which type should be the image?
IMAGE_CLASSES += "dmo-images"
IMAGE_FSTYPES = "tar.bz2 ext4 dmosdcard"
IMAGE_TYPEDEP_dmosdcard = "ext4"

INITRAMFS_IMAGE = "dmo-image-initramfs"

# barebox configurations
IMAGE_BOOTLOADER = "barebox-vertigo"
BAREBOX_MACHINE = "dmo-vertigo_defconfig"
PREFERRED_PROVIDER_virtual/bootloader = "barebox-vertigo"

# kernel configuration
KERNEL_IMAGETYPE = "zImage"
PREFERRED_PROVIDER_virtual/kernel ?= "linux-dmo-vertigo"

PREFERRED_VERSION_linux-dmo ?= "4.4.57%"

SERIAL_CONSOLE = "115200 ttymxc0"

MACHINE_FEATURES += " pci"

SDCARD_WITH_SEPARATED_BARBOXENV = "false"

DMOFTP_append = "/edm-qmx6/source/"

require conf/machine/splash-screen.inc
```

## conf/machine/imx6dl-dmo-edm-qmx6.conf
```bitbake
#@TYPE: Machine
#@NAME: i.MX6DL edm-qmx6
#@DESCRIPTION: Machine configuration for Data-Modul eDM-QMX6

require conf/machine/imx6-dmo-edm-qmx-base.inc

BAREBOX_BINARY = "images/barebox-datamodul-edm-qmx6dl.img"

KERNEL_DEVICETREE = "imx6dl-dmo-edmqmx6.dtb \
                     imx6dl-dmo-edmqmx6-chimei-g070y2.dtb \
                     imx6dl-dmo-edmqmx6-auo-g173hw01.dtb "
DEFAULT_KERNEL_DEVICETREE = "imx6dl-dmo-edmqmx6.dtb"

SOC_FAMILY = "mx6:mx6dl"
```

## conf/machine/imx6dl-dmo-ppc.conf
```bitbake
#@TYPE: Machine
#@NAME: i.MX6DL PPC
#@DESCRIPTION: Machine configuration for Data-Modul PPC Board

require conf/machine/imx6-dmo-ppc-base.inc

BAREBOX_BINARY = "images/barebox-imx6dl-dmo-ppc.img"

KERNEL_DEVICETREE = "imx6dl-dmo-ppc-auo-g804sn05.dtb \
		     imx6dl-dmo-ppc-auo-g173hw01.dtb \
		     imx6dl-dmo-ppc-chimei-g070y2.dtb \
		     imx6dl-dmo-ppc-chimei-g101ICE.dtb "
DEFAULT_KERNEL_DEVICETREE = "imx6dl-dmo-ppc-chimei-g070y2.dtb"

SOC_FAMILY = "mx6:mx6dl:"
MACHINEOVERRIDES =. "mx6dl:"
```

## conf/machine/imx6dl-dmo-vertigo.conf
```bitbake
#@TYPE: Machine
#@NAME: i.MX6DL Vertigo
#@DESCRIPTION: Machine configuration for Data-Modul Vetrigo Board

require conf/machine/imx6-dmo-vertigo-base.inc

BAREBOX_BINARY = "images/barebox-imx6dl-dmo-vertigo.img"

KERNEL_DEVICETREE = "imx6dl-dmo-vertigo-auo-g804sn05.dtb \
		     imx6dl-dmo-vertigo-chimei-g070y2.dtb \
		     imx6dl-dmo-vertigo-chimei-g101ICE.dtb "
DEFAULT_KERNEL_DEVICETREE = "imx6dl-dmo-vertigo-chimei-g070y2.dtb"

SOC_FAMILY = "mx6:mx6dl"
```

## conf/machine/imx6dl-technoalpin-vertigo.conf
```bitbake
#@TYPE: Machine
#@NAME: i.MX6DL Vertigo
#@DESCRIPTION: Machine configuration for Data-Modul Vetrigo Board

require conf/machine/imx6-dmo-vertigo-base.inc

BAREBOX_BINARY = "images/barebox-imx6dl-dmo-vertigo.img"

PREFERRED_PROVIDER_virtual/kernel = "linux-tna-vertigo"
PREFERRED_VERSION_linux-dmo = "4.1.%"
KERNEL_DEVICETREE = "imx6dl-tna-vertigo-chimei-g101ICE.dtb"
DEFAULT_KERNEL_DEVICETREE = "imx6dl-tna-vertigo-chimei-g101ICE.dtb"

SPLASH_SCREEN_IMAGE = "BootLogo_20170918.png"
SPLASH_SCREEN_TYPE = "kernel"
SPLASH_SCREEN_DIMENSION = "1280x800!"

SOC_FAMILY = "mx6:mx6dl"
```

## conf/machine/imx6q-dmo-edm-qmx6.conf
```bitbake
#@TYPE: Machine
#@NAME: i.MX6Q edm-qmx6
#@DESCRIPTION: Machine configuration for Data-Modul eDM-QMX6

require conf/machine/imx6-dmo-edm-qmx-base.inc

BAREBOX_BINARY = "images/barebox-datamodul-edm-qmx6q.img"

KERNEL_DEVICETREE = "imx6q-dmo-edmqmx6.dtb \
                     imx6q-dmo-edmqmx6-chimei-g070y2.dtb \
                     imx6q-dmo-edmqmx6-auo-g173hw01.dtb "
DEFAULT_KERNEL_DEVICETREE = "imx6q-dmo-edmqmx6.dtb"

SOC_FAMILY = "mx6q:mx6"
```

## conf/machine/imx6q-dmo-ppc.conf
```bitbake
#@TYPE: Machine
#@NAME: i.MX6Q PPC
#@DESCRIPTION: Machine configuration for Data-Modul PPC Board

require conf/machine/imx6-dmo-ppc-base.inc

KERNEL_DEVICETREE = "imx6q-dmo-ppc-auo-g804sn05.dtb \
		     imx6q-dmo-ppc-auo-g173hw01.dtb \
		     imx6q-dmo-ppc-chimei-g070y2_12018614.dtb \
		     imx6q-dmo-ppc-chimei-g101ICE_12018182.dtb \
		     imx6q-dmo-ppc-chimei-g121I1_12018381.dtb \
		     imx6q-dmo-ppc-HDMI.dtb "
DEFAULT_KERNEL_DEVICETREE = "imx6q-dmo-ppc-chimei-g070y2_12018614.dtb"

SOC_FAMILY = "mx6:mx6q"
MACHINEOVERRIDES =. "mx6q:"
```
